## meta-creality-k1/conf/layer.conf
```bitbake
BBPATH .= ":${LAYERDIR}"

BBFILES += "${LAYERDIR}/recipes-*/*/*.bb \
            ${LAYERDIR}/recipes-*/*/*.bbappend"

BBFILE_COLLECTIONS += "creality-k1"
BBFILE_PATTERN_creality-k1 = "^${LAYERDIR}/"
BBFILE_PRIORITY_creality-k1 = "10"

LAYERDEPENDS_creality-k1 = "core openembedded-layer meta-python webserver"
LAYERSERIES_COMPAT_creality-k1 = "scarthgap"

CREALITY_K1_LAYERDIR = "${LAYERDIR}"
```
